## config/boards/shields/dactyl-stabilized/Kconfig.defconfig
```kconfig
if SHIELD_DACTYL_STABILIZED_LEFT

config ZMK_KEYBOARD_NAME
    default "dstab-left"

config ZMK_SPLIT_BLE_ROLE_CENTRAL
    default y

endif

if SHIELD_DACTYL_STABILIZED_RIGHT

config ZMK_KEYBOARD_NAME
    default "dstab-right"

endif

if SHIELD_DACTYL_STABILIZED_LEFT || SHIELD_DACTYL_STABILIZED_RIGHT

config ZMK_SPLIT
    default y

endif
```

## config/boards/shields/dactyl-stabilized/Kconfig.shield
```kconfig
config SHIELD_DACTYL_STABILIZED_LEFT
    def_bool $(shields_list_contains,dactyl-stabilized_left)

config SHIELD_DACTYL_STABILIZED_RIGHT
    def_bool $(shields_list_contains,dactyl-stabilized_right)
```
