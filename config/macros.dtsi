macro_undo: macro_undo {
  compatible = "zmk,behavior-macro";
  label = "macro_undo";
  #binding-cells = <0>;
  bindings = <&kp LGUI>, <&kp Z>;
};

macro_redo: macro_redo {
  compatible = "zmk,behavior-macro";
  label = "macro_redo";
  #binding-cells = <0>;
  bindings = <&kp LGUI>, <&kp LSHIFT>, <&kp Z>;
};